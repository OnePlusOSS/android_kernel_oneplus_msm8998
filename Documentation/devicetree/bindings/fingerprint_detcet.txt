## Documentation/devicetree/bindings/fingerprint_detcet.txt
```
fingerprint

Required Properties:
- compatible:			Must be "ompatible = "oneplus,fpdetect".
```

## Documentation/devicetree/bindings/input/fpc1020_tee.txt
```
fpc Fingerprint

Required Properties:
- compatible:			Must be "ompatible = "fpc,fpc1020".


Example:

	/* Fingerprint */
	fpc_fpc1020 {
		compatible = "fpc,fpc1020";
		interrupt-parent = <&tlmm>;
		fpc,irq-gpio    = <&tlmm 121 0>;
		/*
		fpc,gpio_id0    = <&tlmm 39 0>;
		fpc,gpio_id1    = <&tlmm 41 0>;
		fpc,gpio_id2    = <&tlmm 63 0>;
		*/
	};
```

## Documentation/devicetree/bindings/input/touchscreen/synaptics_driver_s3320.txt
```
synaptics,s3320

Required properties:
- compatible : should be "synaptics,s3320"

Example:
	synaptics-rmi-ts@20 {
		compatible = "synaptics,s3320";
	};
```

## Documentation/devicetree/bindings/input/tri_state_key.txt
```
Tri-state key

Required Properties:
- compatible:			Must be "ompatible = "oneplus,tri-state-key".


Example:

        tri_state_key {
                compatible = "oneplus,tri-state-key";
                status = "okay";
                interrupt-parent = <&tlmm>;
                tristate,gpio_key1 = <&tlmm 40 0x00>;
                tristate,gpio_key2 = <&tlmm 42 0x00>;
                tristate,gpio_key3 = <&tlmm 26 0x00>;
                pinctrl-names = "pmx_tri_state_key_active",
                "pmx_tri_state_key_suspend";
                pinctrl-0 = <&tri_state_key_active>;
                pinctrl-1 = <&tri_state_key_suspend>;
        };
```

## Documentation/devicetree/bindings/misc/bootloader_log.txt
```
Bootloader_log

Required properties:
- compatible : should be "bootloader_log"

Example:
	bootloader_log {
		compatible = "bootloader_log";
	};
```

## Documentation/devicetree/bindings/misc/goodix_fingerprint_tee.txt
```
Goodix Fingerprint TEE driver

Required properties:

-compatible	: should be "goodix,fingerprint".
-interrupt-parent : gpio interrupt parent declare
-fp-gpio-irq : irq gpio declare
-fp-gpio-reset : reset gpio declare

Example:

goodix_fp {
	compatible = "goodix,fingerprint";
	interrupt-parent = <&tlmm>;
	fp-gpio-irq = <&tlmm 58 0x00>;
	fp-gpio-reset = <&tlmm 59 0x00>;
	status = "okay";
};
```

## Documentation/devicetree/bindings/power/bq27541.txt
```
ti,bq27541-battery



Required properties:

- compatible : should be "ti,bq27541-battery"


Example:

          bq27541-battery@55 {

           status = "ok";

           compatible = "ti,bq27541-battery";

           reg = <0x55>;

           qcom,modify-soc-smooth;
```

## Documentation/devicetree/bindings/power/oneplus_fastchg.txt
```
crochip,oneplus_fastcg"



Required properties:

- compatible : should be "microchip,oneplus_fastcg"


Example:
	oneplus_fastcg@26{

               status = "ok";

               compatible = "microchip,oneplus_fastcg";

               reg = <0x26>;

               microchip,mcu-en-gpio = <&tlmm 96 0x00>;

               microchip,usb-sw-1-gpio = <&tlmm 15 0x00>;
```

## Documentation/devicetree/bindings/power/supply/qcom/bq27541_fuelgauger.txt
```
BQ27541 battery charger

BQ27541 is a single-cell switching mode battery charger. It can charge
the battery and power the system via the USB and AC adapter input.

The BQ27541 interface is via I2C bus.

Required Properties:
- compatible:			Must be "ti,bq27541-battery".
- reg:				The device 7-bit I2C address.


Example:

&i2c_7 {
        bq27541-battery@55 {
                status = "ok";
                compatible = "ti,bq27541-battery";
                reg = <0x55>;
                qcom,modify-soc-smooth;
                };

	};
```

## Documentation/devicetree/bindings/power/supply/qcom/oneplus_fastcg.txt
```
oneplus_fastcg

BQ27541 is a single-cell switching mode battery charger. It can charge
the battery and power the system via the USB and AC adapter input.

The BQ27541 interface is via I2C bus.

Required Properties:
- compatible:			Must be "ompatible = "microchip,oneplus_fastcg".
- reg:				    The device 7-bit I2C address.


Example:

&i2c_7 {
        oneplus_fastcg@26{
                status = "ok";
                compatible = "microchip,oneplus_fastcg";
                reg = <0x26>;
                microchip,mcu-en-gpio = <&tlmm 96 0x00>;
                microchip,usb-sw-1-gpio = <&tlmm 90 0x00>;
                microchip,usb-sw-2-gpio = <&tlmm 91 0x00>;
                microchip,ap-clk = <&tlmm 79 0x00>;
                microchip,ap-data = <&tlmm 80 0x00>;

                pinctrl-names = "mux_fastchg_active", "mux_fastchg_suspend";
                pinctrl-0 = <&fastchg_active &usb_sw_active
                        &ap_clk_active &ap_data_active>;
                pinctrl-1 = <&usb_sw_suspend &fastchg_suspend
                        &ap_clk_suspend &ap_data_suspend>;
        };

	};
```

## Documentation/devicetree/bindings/serial/msm_serial.txt
```
oem force serial

Required properties:
- compatible : should be "oem,force_serial"

Example:
	force_enable_serial {
		compatible = "oem,force_serial";
	};

Required properties:
- compatible : should be "em,oem_serial_pinctrl"

Example:
   oem_serial_pinctrl {
        compatible = "oem,oem_serial_pinctrl";
	};
```

## Documentation/devicetree/bindings/soc/qcom/op_rf_cable_monitor.txt
```
Op_rf_cable_monitor

Required properties:
- compatible : should be "oem,rf_cable"

Example:
	oem_rf_cable {
		compatible = "oem,rf_cable";
	};
```

## Documentation/devicetree/bindings/sound/tfa98xx.txt
```
nxp,tfa9891

Required properties:
- compatible : should be "nxp,tfa9891"

Example:
	bootloader_log {
		compatible = "nxp,tfa9891";
	};
```

## drivers/input/misc/fingerprint_detect/Kconfig
```kconfig
config FINGERPRINT_DETECT
	default y
	tristate "fingerprint detect support"
	depends on SPI_MASTER
```

## drivers/input/misc/goodixfingerprint/Kconfig
```kconfig
config FINGERPRINT_GOODIX
	default y
	tristate "goodix fingerprint sensor support"
	depends on SPI_MASTER
```

## drivers/nfc/pn544/Kconfig
```kconfig
#
# Near Field Communication (NFC) devices
#


config NXP_NFC_I2C
	tristate "QTI NCI based NFC Controller Driver for NQx"
	help
	  This enables the NFC driver for NQx based devices.
	  This is for i2c connected version. NCI protocol logic
	  resides in the usermode and it has no other NFC dependencies.

config NXP_NFC_SPI
	tristate "QTI NCI based NFC Controller Driver for NQx"
	help
	  This enables the NFC driver for NQx based devices.
	  This is for spi connected version. NCI protocol logic
	  resides in the usermode and it has no other NFC dependencies.
```

## drivers/oneplus/Kconfig
```kconfig
config OEM_DEBUG_SUPPORT
        bool
        default y

config OEM_TRACE_SUPPORT
	default y
	depends on OEM_DEBUG_SUPPORT
	bool "OEM debug function, enable it will register the device, which under /dev/otracer."
```
