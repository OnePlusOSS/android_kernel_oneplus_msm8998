/* Copyright (c) 2015-2017, The Linux Foundation. All rights reserved.
 *
 * This program is free software; you can redistribute it and/or modify
 * it under the terms of the GNU General Public License version 2 and
 * only version 2 as published by the Free Software Foundation.
 *
 * This program is distributed in the hope that it will be useful,
 * but WITHOUT ANY WARRANTY; without even the implied warranty of
 * MERCHANTABILITY or FITNESS FOR A PARTICULAR PURPOSE.  See the
 * GNU General Public License for more details.
 */

#include "dsi-panel-samsung_s6e3fa3_1080p_cmd.dtsi"
#include "dsi-panel-samsung_s6e3fa3_1080p_video.dtsi"
#include "dsi-panel-samsung_s6e3fa5_1080p_cmd.dtsi"
#include "dsi-panel-samsung_s6e3fa6_1080p_cmd.dtsi"

&dsi_samsung_s6e3fa3_1080p_cmd {
  qcom,panel-supply-entries = <&dsi_panel_pwr_supply_no_labibb>;
};

&dsi_samsung_s6e3fa3_1080p_video {
  qcom,panel-supply-entries = <&dsi_panel_pwr_supply_no_labibb>;
};

&dsi_samsung_s6e3fa5_1080p_cmd {
  qcom,panel-supply-entries = <&dsi_panel_pwr_supply_no_labibb>;
};

&dsi_samsung_s6e3fa6_1080p_cmd {
  qcom,panel-supply-entries = <&dsi_panel_pwr_supply_no_labibb>;
};
