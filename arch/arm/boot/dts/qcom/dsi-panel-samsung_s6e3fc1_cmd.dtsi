/* Copyright (c) 2014, The Linux Foundation. All rights reserved.
 *
 * This program is free software; you can redistribute it and/or modify
 * it under the terms of the GNU General Public License version 2 and
 * only version 2 as published by the Free Software Foundation.
 *
 * This program is distributed in the hope that it will be useful,
 * but WITHOUT ANY WARRANTY; without even the implied warranty of
 * MERCHANTABILITY or FITNESS FOR A PARTICULAR PURPOSE.  See the
 * GNU General Public License for more details.
 */

/*---------------------------------------------------------------------------
 * This file is autogenerated file using gcdb parser. Please do not edit it.
 * Update input XML file to add a new entry or update variable in this file
 * VERSION = "1.0"
 *---------------------------------------------------------------------------*/
&mdss_mdp {
	dsi_samsung_s6e3fc1_cmd: qcom,mdss_dsi_samsung_s6e3fc1_cmd {
		qcom,cont-splash-enabled;
		qcom,mdss-dsi-panel-name = "samsung s6e3fc1 cmd mode dsi panel";
		qcom,mdss-dsi-panel-manufacture = "SAMSUNG";
		qcom,mdss-dsi-panel-version = "S6E3FC1";
		qcom,mdss-dsi-backlight-version = "SAMSUNG";
		qcom,mdss-dsi-backlight-manufacture = "SAMSUNG";
		qcom,mdss-dsi-panel-controller = <&mdss_dsi0>;
		qcom,mdss-dsi-panel-type = "dsi_cmd_mode";
		qcom,mdss-dsi-panel-destination = "display_1";
		qcom,mdss-dsi-panel-framerate = <60>;
		qcom,mdss-dsi-virtual-channel-id = <0>;
		qcom,mdss-dsi-stream = <0>;
		qcom,mdss-dsi-panel-width = <1080>;
		qcom,mdss-dsi-panel-height = <2160>;
		qcom,mdss-dsi-h-front-porch = <128>;
		qcom,mdss-dsi-h-back-porch = <64>;
		qcom,mdss-dsi-h-pulse-width = <16>;
		qcom,mdss-dsi-h-sync-skew = <0>;
		qcom,mdss-dsi-v-back-porch = <4>;
		qcom,mdss-dsi-v-front-porch = <18>;
		qcom,mdss-dsi-v-pulse-width = <2>;
		qcom,mdss-dsi-h-left-border = <0>;
		qcom,mdss-dsi-h-right-border = <0>;
		qcom,mdss-dsi-v-top-border = <0>;
		qcom,mdss-dsi-v-bottom-border = <0>;
		qcom,mdss-dsi-bpp = <24>;
		qcom,mdss-dsi-color-order = "rgb_swap_rgb";
		qcom,mdss-dsi-underflow-color = <0xff>;
		qcom,mdss-dsi-border-color = <0>;
		qcom,mdss-dsi-on-command = [
		05 01 00 00 19 00 02 11 00
		15 01 00 00 00 00 02 35 00
		39 01 00 00 00 00 03 FC 5A 5A
		39 01 00 00 00 00 04 E8 64 08 0C
		39 01 00 00 00 00 03 FC A5 A5
		39 01 00 00 00 00 03 F0 5A 5A
		39 01 00 00 00 00 02 B0 01
		39 01 00 00 00 00 02 ED 04
		39 01 00 00 00 00 03 F0 A5 A5
		15 01 00 00 00 00 02 53 20
		15 01 00 00 00 00 02 55 00
		05 01 00 00 00 00 02 29 00
                ];

		qcom,mdss-dsi-off-command = [05 01 00 00 0A 00 02 28 00
					05 01 00 00 A0 00 02 10 00];
		qcom,mdss-dsi-post-panel-on-command = [05 01 00 00 00 00 02 29 00];
		qcom,mdss-dsi-on-command-state = "dsi_lp_mode";
		qcom,mdss-dsi-off-command-state = "dsi_hs_mode";
		qcom,mdss-dsi-h-sync-pulse = <1>;
		qcom,mdss-dsi-traffic-mode = "burst_mode";
		qcom,mdss-dsi-lane-map = "lane_map_0123";
		qcom,mdss-dsi-bllp-eof-power-mode;
		qcom,mdss-dsi-bllp-power-mode;
		qcom,mdss-dsi-lane-0-state;
		qcom,mdss-dsi-lane-1-state;
		qcom,mdss-dsi-lane-2-state;
		qcom,mdss-dsi-lane-3-state;
		qcom,mdss-dsi-panel-timings = [00 20 07 07 0c 12 06 08 06 03 04 00];
		qcom,mdss-dsi-te-pin-select = <1>;
		qcom,mdss-dsi-te-v-sync-rd-ptr-irq-line = <0x2c>;
		qcom,mdss-dsi-te-v-sync-continue-lines = <0x3c>;
		qcom,mdss-dsi-te-dcs-command = <1>;
		qcom,esd-check-enabled;
		qcom,mdss-dsi-panel-status-check-mode = "te_signal_check";
		qcom,mdss-dsi-te-check-enable;
		qcom,mdss-dsi-te-using-te-pin;
		qcom,mdss-dsi-t-clk-post = <0x08>;
		qcom,mdss-dsi-t-clk-pre = <0x30>;
		qcom,mdss-dsi-bl-min-level = <1>;
		qcom,mdss-dsi-bl-max-level = <1023>;
		qcom,mdss-dsi-dma-trigger = "trigger_sw";
		qcom,mdss-dsi-mdp-trigger = "trigger_sw";
		qcom,mdss-dsi-bl-pmic-control-type = "bl_ctrl_dcs";
		qcom,mdss-dsi-lp11-init;
		qcom,mdss-dsi-init-delay-us = <10000>;
		qcom,mdss-dsi-reset-sequence = <1 2>,<0 2>, <1 2>;
		/*qcom,mdss-dsi-panel-inverted;*/
		qcom,mdss-pan-physical-width-dimension = <68>;
		qcom,mdss-pan-physical-height-dimension = <137>;
		qcom,mdss-tear-check-frame-rate=<6000>;
		/* Height + VBP + VFP + VSW */
		//qcom,mdss-tear-check-sync-cfg-height = <1932>;
		//qcom,mdss-tear-check-sync-init-val= <1920>; /* Height */
	  //qcom,mdss-tear-check-sync-threshold-start = <4>;
	  //qcom,mdss-tear-check-sync-threshold-continue = <4>;
	  //qcom,mdss-tear-check-start-pos= <1920>; /* Height */
	  //qcom,mdss-tear-check-rd-ptr-trigger-intr= <1921>; /* Height + 1 */
		qcom,mdss-brightness-max-level = <1023>;
		qcom,mdss-dsi-high-brightness-panel;
		qcom,mdss-dsi-panel-acl-command = [15 01 00 00 00 00 02 55 00];
		qcom,mdss-dsi-acl-command-state = "dsi_hs_mode";
		qcom,mdss-dsi-acl-ncmds = <0>;
		qcom,mdss-dsi-acl-npayload = <1>;
		qcom,mdss-dsi-panel-hbm-on-command = [15 01 00 00 00 00 02 53 E8];
		qcom,mdss-dsi-panel-hbm-off-command = [15 01 00 00 00 00 02 53 28];
		qcom,mdss-dsi-hbm-command-state = "dsi_hs_mode";
		/**************************************/
		//if you need read the lcd register value
		//you can modify the qcom,mdss-dsi-id-command
		qcom,mdss-dsi-read-reg-enable-command  = [39 01 00 00 00 00 03 F0 5A 5A];
		qcom,mdss-dsi-read-reg-disable-command = [29 01 00 00 00 00 03 F0 A5 A5];
		qcom,mdss-dsi-packetsizetxcmds-command = [37 01 00 00 00 00 02 07 00];
		qcom,mdss-dsi-readpostxcmds-command =     [15 01 00 00 00 00 02 B0 00];
		//read C3 25~35th , 25=0x19
		qcom,mdss-dsi-id-command = [ 06 01 00 00 00 00 01 C3 0A 19];
		qcom,mdss-dsi-packetsizetxcmds-command-state = "dsi_lp_mode";
		qcom,mdss-dsi-readpostxcmds-command-state    = "dsi_lp_mode";
		qcom,mdss-dsi-read-reg-enable-command-state  =  "dsi_lp_mode";
		qcom,mdss-dsi-read-reg-disable-command-state =  "dsi_lp_mode";
		qcom,mdss-dsi-id-command-state = "dsi_lp_mode";
		qcom,mdss-bl-high2bit;
		qcom,mdss-dsi-tx-eot-append;
		qcom,mdss-dsi-panel-seria-num-command = [06 01 00 00 00 00 01 A1];
		qcom,mdss-dsi-panel-seria-num-state = "dsi_lp_mode";
		qcom,mdss-dsi-panel-seria-num-year-index = <12>;
		qcom,mdss-dsi-panel-seria-num-mon-index = <12>;
		qcom,mdss-dsi-panel-seria-num-day-index = <13>;
		qcom,mdss-dsi-panel-seria-num-hour-index = <14>;
		qcom,mdss-dsi-panel-seria-num-min-index = <15>;

			qcom,mdss-dsi-panel-srgb-on-command = [
				39 01 00 00 00 00 03 f0 5A 5A
				39 01 00 00 00 00 02 BC 01
				39 01 00 00 00 00 02 B0 01
				39 01 00 00 00 00 02 BC 12
				39 01 00 00 00 00 02 B0 2C
				39 01 00 00 00 00 16 bc A3 05 04 46 cd 10 05 09 b0 57 ef cf bb 11 bf e1 da 17 ff f9 d8
				39 01 00 00 00 00 02 b0 42
				39 01 00 00 00 00 02 bc 03
				39 01 00 00 00 00 02 b0 4B
				39 01 00 00 00 00 02 bc A1
				39 01 00 00 00 00 03 f0 A5 A5
				];
			qcom,mdss-dsi-panel-srgb-off-command = [
				39 01 00 00 00 00 03 F0 5A 5A
				39 01 00 00 00 00 03 BC E0 00
				39 01 00 00 00 00 03 F0 A5 A5
				];
			qcom,mdss-dsi-srgb-command-state = "dsi_hs_mode";
			qcom,mdss-dsi-panel-dci-p3-on-command = [
				39 01 00 00 00 00 03 f0 5A 5A
				39 01 00 00 00 00 02 BC 01
				39 01 00 00 00 00 02 B0 01
				39 01 00 00 00 00 02 BC 12
				39 01 00 00 00 00 02 B0 2C
				39 01 00 00 00 00 16 BC C6 00 00 1e cf 00 06 0a c3 26 ef cd e0 04 ce e9 df 00 ff f9 d8
				39 01 00 00 00 00 02 b0 42
				39 01 00 00 00 00 02 bc 03
				39 01 00 00 00 00 02 b0 4B
				39 01 00 00 00 00 02 bc A1
				39 01 00 00 00 00 03 f0 A5 A5
				];
			qcom,mdss-dsi-panel-dci-p3-off-command = [
				39 01 00 00 00 00 03 F0 5A 5A
				39 01 00 00 00 00 03 BC E0 00
				39 01 00 00 00 00 03 F0 A5 A5
				];
			qcom,mdss-dsi-dci-p3-command-state = "dsi_hs_mode";
/*****************************************************************************/
			qcom,mdss-dsi-panel-night-mode-on-command = [
				39 01 00 00 00 00 03 f0 5A 5A
				39 01 00 00 00 00 03 BC 01 12
				39 01 00 00 00 00 02 B0 2C
				39 01 00 00 00 00 16 BC A0 02 04 3B C7 12 08 07 A8 4B E7 C9 BF 0A B9 E3 DA 18 FF FE FA
				39 01 00 00 00 00 03 f0 A5 A5
				];
			qcom,mdss-dsi-panel-night-mode-off-command = [
				39 01 00 00 00 00 03 F0 5A 5A
				39 01 00 00 00 00 03 BC E0 00
				39 01 00 00 00 00 03 F0 A5 A5
				];
			qcom,mdss-dsi-night-mode-command-state = "dsi_hs_mode";
			qcom,mdss-dsi-panel-oneplus-mode-on-command = [
				39 01 00 00 00 00 03 f0 5a 5a
				39 01 00 00 00 00 03 bc 01 12
				39 01 00 00 00 00 02 b0 2c
				39 01 00 00 00 00 16 bc b4 02 04 05 ff 02 00 00 ff 00 ff ff f0 00 f0 e0 e1 18 ff fe fB
				39 01 00 00 00 00 03 f0 a5 a5
				39 01 00 00 00 00 03 f0 5a 5a
				39 01 00 00 00 00 02 bc 01
				39 01 00 00 00 00 02 b0 42
				39 01 00 00 00 00 02 bc 03
				39 01 00 00 00 00 02 b0 4b
				39 01 00 00 00 00 02 bc 01
				39 01 00 00 00 00 03 f0 a5 a5
				];
			qcom,mdss-dsi-panel-oneplus-mode-off-command = [
				39 01 00 00 00 00 03 F0 5A 5A
				39 01 00 00 00 00 03 BC E0 00
				39 01 00 00 00 00 03 F0 A5 A5
				];
			qcom,mdss-dsi-read-mode-command-state = "dsi_hs_mode";
			qcom,mdss-dsi-panel-adaption-mode-on-command = [
				39 01 00 00 00 00 03 f0 5a 5a
				39 01 00 00 00 00 03 bc 01 12
				39 01 00 00 00 00 02 b0 2c
				39 01 00 00 00 00 16 bc B8 03 04 45 E2 10 04 07 C1 4B EB D7 B8 0A BF FF ED 14 FF FF FA
				39 01 00 00 00 00 03 f0 a5 a5
				39 01 00 00 00 00 03 f0 5a 5a
				39 01 00 00 00 00 02 bc 01
				39 01 00 00 00 00 02 b0 42
				39 01 00 00 00 00 02 bc 03
				39 01 00 00 00 00 02 b0 4b
				39 01 00 00 00 00 02 bc 01
				39 01 00 00 00 00 03 f0 a5 a5
				];
			qcom,mdss-dsi-panel-adaption-mode-off-command = [
				39 01 00 00 00 00 03 F0 5A 5A
				39 01 00 00 00 00 03 BC E0 00
				39 01 00 00 00 00 03 F0 A5 A5
				];
			qcom,mdss-dsi-adaption-mode-command-state = "dsi_hs_mode";

/**************************************************************************/
	};
};
