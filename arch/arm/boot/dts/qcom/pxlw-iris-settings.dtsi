/* Copyright (c) 2013, The Linux Foundation. All rights reserved.
 *
 * This program is free software; you can redistribute it and/or modify
 * it under the terms of the GNU General Public License version 2 and
 * only version 2 as published by the Free Software Foundation.
 *
 * This program is distributed in the hope that it will be useful,
 * but WITHOUT ANY WARRANTY; without even the implied warranty of
 * MERCHANTABILITY or FITNESS FOR A PARTICULAR PURPOSE.  See the
 * GNU General Public License for more details.
 */

/*---------------------------------------------------------------------------
 * This file is autogenerated file using gcdb parser. Please do not edit it.
 * Update input XML file to add a new entry or update variable in this file
 * VERSION = "1.0"
 *---------------------------------------------------------------------------*/
&mdss_mdp {
	pxlw_iris_settings: pxlw,mdss_iris_settings {
		/*iris last frame repeat cnt*/
		pxlw,iris-last-frame-repeat-cnt = <0x00>;

		/*disable dbc settings*/
		pxlw,iris-disable-dbc-dlv-sensitivity = <0x00>;
		pxlw,iris-disable-dbc-quality = <0x00>;

		/*disable pq settings*/
		pxlw,iris-disable-pq-peaking = <0x00>;
		pxlw,iris-disable-pq-peaking-demo= <0x00>;
		pxlw,iris-disable-pq-gamma = <0x00>;
		pxlw,iris-disable-pq-contrast = <0x32>;

		/*disable lce setting*/
		pxlw,iris-disable-lce = <0x00>;

		/*disable cm*/
		pxlw,iris-disable-cm-c6axes = <0x00>;
		pxlw,iris-disable-cm-c3d = <0x00>;
		pxlw,iris-disable-cm-fleshtone = <0x00>;
		pxlw,iris-disable-color-temp-en = <0x00>;
    pxlw,iris-disable-reading-mode = <0x00>;
		/*disable color adjust*/
		pxlw,iris-disable-color-adjust = <0x32>;

		/*use analog bypass or bypass*/
		pxlw,iris-is-analog-bypass = <0x1>;

		/*default setting for APPCODE init data */
		pxlw,iris-pq-peaking-default = <0x00>;
		pxlw,iris-pq-sharpness-default = <0x00>;
		pxlw,iris-pq-memc-demo-mode-default = <0x00>;
		pxlw,iris-pq-peaking-demo-mode-default = <0x00>;
		pxlw,iris-pq-gamma-mode-default = <0x00>;
		pxlw,iris-pq-memclevel-default = <0x03>;
		pxlw,iris-pq-contrast-default = <0x32>;
		pxlw,iris-pq-cinema-default = <0x00>;

		pxlw,iris-cabcmode-default = <0x01>;

		pxlw,iris-color-adjust-default = <0x32>;

		pxlw,iris-lce-mode-default = <0x00>;
		pxlw,iris-lce-mode1-level-default = <0x01>;
		pxlw,iris-lce-mode2-level-default = <0x01>;
		pxlw,iris-lce-demo-mode-default = <0x00>;
		pxlw,iris-lux-value-default = <0x00>;
		pxlw,iris-cct-value-default = <0x00>;

		pxlw,iris-reading-mode-default = <0x00>;

		pxlw,iris-cm-6axes-default = <0x00>;
		pxlw,iris-cm-3d-default = <0x00>;
		pxlw,iris-cm-demo-mode-default = <0x00>;
		pxlw,iris-cm-fleshtone-default = <0x00>;
		pxlw,iris-color-temp-en-default = <0x00>;
		pxlw,iris-color-temp-default = <0x00>;
		pxlw,iris-sensor-auto-en-default = <0x00>;

		/* setting for AP init data */
		pxlw,iris-pq-peaking-init = <0x00>;
		pxlw,iris-pq-sharpness-init = <0x00>;
		pxlw,iris-pq-memc-demo-mode-init = <0x00>;
		pxlw,iris-pq-peaking-demo-mode-init = <0x00>;
		pxlw,iris-pq-gamma-mode-init = <0x00>;
		pxlw,iris-pq-memclevel-init = <0x03>;
		pxlw,iris-pq-contrast-init = <0x32>;
		pxlw,iris-pq-cinema-init = <0x00>;

		pxlw,iris-cabcmode-init = <0x00>;

		pxlw,iris-color-adjust-init = <0x32>;

		pxlw,iris-lce-mode-init = <0x00>;
		pxlw,iris-lce-mode1-level-init = <0x01>;
		pxlw,iris-lce-mode2-level-init = <0x01>;
		pxlw,iris-lce-demo-mode-init = <0x00>;

		pxlw,iris-lux-value-init = <0x00>;
		pxlw,iris-cct-value-init = <0x00>;
		pxlw,iris-reading-mode-init = <0x00>;
		pxlw,iris-cm-6axes-init = <0x00>;
		pxlw,iris-cm-3d-init = <0x00>;
		pxlw,iris-cm-demo-mode-init = <0x00>;
		pxlw,iris-cm-fleshtone-init = <0x00>;
		pxlw,iris-color-temp-en-init = <0x00>;
		pxlw,iris-color-temp-init = <0x00>;
		pxlw,iris-sensor-auto-en-init = <0x00>;
	};
};

